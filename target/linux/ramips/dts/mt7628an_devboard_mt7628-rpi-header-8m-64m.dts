// SPDX-License-Identifier: GPL-2.0-or-later OR MIT

#include "mt7628an_devboard_mt7628-8m-64m.dtsi"

#include <dt-bindings/gpio/gpio.h>

/ {
	compatible = "devboard,mt7628-rpi-header-8m-64m", "mediatek,mt7628an-soc";
	model = "DevBoard MT7628 RPi Header (8M Flash / 64M RAM)";

	leds {
		compatible = "gpio-leds";

		ethernet-yellow {
			label = "yellow:ethernet";
			gpios = <&gpio 42 GPIO_ACTIVE_LOW>;
			default-state = "off";
		};
	};
};

&gpio {
	gpio-line-names =
		"J5_PIN38_I2S_DIN",
		"J5_PIN40_I2S_DOUT",
		"J5_PIN35_I2S_WS",
		"J5_PIN12_I2S_CLK",
		"J5_PIN5_I2C_SCL",
		"J5_PIN3_I2C_SDA",
		"J5_PIN24_SPI_CE0_N",
		"J5_PIN23_SPI_CLK",
		"J5_PIN19_SPI_MOSI",
		"J5_PIN21_SPI_MISO",
		"",
		"J5_PIN7_HAT_GPIO4",
		"",
		"",
		"J5_PIN32_HAT_PWM0",
		"J5_PIN33_HAT_PWM1",
		"J5_PIN36_HAT_GPIO16",
		"J5_PIN11_HAT_GPIO17",
		"J5_PIN29_HAT_GPIO5",
		"J5_PIN31_HAT_GPIO6",
		"",
		"",
		"",
		"",
		"J5_PIN22_SDIO_D1",
		"J5_PIN18_SDIO_D0",
		"J5_PIN15_SDIO_CLK",
		"J5_PIN37_SDIO_D2",
		"J5_PIN16_SDIO_CMD",
		"J5_PIN13_SDIO_D3",
		"",
		"",
		"",
		"",
		"",
		"",
		"",
		"",
		"",
		"J5_PIN26_CUSTOM_GPIO",
		"J5_PIN27_CUSTOM_GPIO",
		"J5_PIN28_CUSTOM_GPIO",
		"ETHERNET_YELLOW_LED",
		"",
		"",
		"J5_PIN8_UART1_TX",
		"J5_PIN10_UART1_RX";
};
